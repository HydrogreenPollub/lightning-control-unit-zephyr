## boards/hydrogreen/lightning_control_unit/board.yml
```yaml
board:
  name: lightning_control_unit
  full_name: Hydrogreen Lightning Control Unit
  vendor: hydrogreen
  socs:
    - name: stm32g491xx
```
